## firmware/main/Kconfig.projbuild
```kconfig
menu "Raah"

    menu "Display"
        choice RAAH_LCD_CONTROLLER
            prompt "LCD controller"
            default RAAH_LCD_ILI9341
            config RAAH_LCD_ST7789
                bool "ST7789 (2.0\"/2.4\" 240x320 IPS)"
            config RAAH_LCD_ILI9341
                bool "ILI9341 (2.4\"/2.8\" 240x320 TN/IPS)"
        endchoice

        config RAAH_LCD_H_RES
            int "Horizontal resolution"
            default 240
        config RAAH_LCD_V_RES
            int "Vertical resolution"
            default 320
            help
                The UI is laid out for 240x320 portrait.
        config RAAH_LCD_SPI_MHZ
            int "SPI clock (MHz)"
            range 10 80
            default 40
            help
                40 MHz is safe on jumper wires. Short, soldered wiring usually runs at 80 MHz.
        config RAAH_LCD_INVERT
            bool "Invert colours (most IPS ST7789 panels need this)"
            default y if RAAH_LCD_ST7789
            default n
        config RAAH_LCD_BGR
            bool "Panel uses BGR element order"
            default y if RAAH_LCD_ILI9341
            default n
        config RAAH_LCD_SWAP_XY
            bool "Swap X and Y"
            default y if RAAH_LCD_ILI9341
            default n
            help
                The 2.8" red-PCB ILI9341 module scans as 320x240 landscape: without this, only 240 of its
                320 columns get drawn and rows past 240 wrap to the top. Swapped, the UI is portrait with the
                pin header at the bottom.
        config RAAH_LCD_MIRROR_X
            bool "Mirror X"
            default n
        config RAAH_LCD_MIRROR_Y
            bool "Mirror Y"
            default n
        config RAAH_LCD_GAP_X
            int "Column offset"
            default 0
        config RAAH_LCD_GAP_Y
            int "Row offset"
            default 0

        # Defaults on the XIAO ESP32C3, the case's board: SCK, MOSI and CS on the C3's direct SPI pins
        # (D4, D5, D10), DC on D8, RESET on D7 and the backlight on D6. GPIO2 and 9 are strapping pins and
        # stay free. The README has the whole wiring table.
        # On the Edgehax S3 Pro test board: six neighbouring pins on the left header (same header as the
        # ESP32-S3-DevKitC-1), in the ILI9341 module's own pin order. GPIO9-14 are avoided because the
        # S3 Pro wires its microSD slot to GPIO10-14, and GPIO35-37 belong to the N16R8's octal PSRAM.
        config RAAH_PIN_LCD_CS
            int "CS GPIO"
            default 10 if IDF_TARGET_ESP32C3
            default 4
        config RAAH_PIN_LCD_RST
            int "RESET GPIO (-1 if tied to EN)"
            default 20 if IDF_TARGET_ESP32C3
            default 5
        config RAAH_PIN_LCD_DC
            int "DC (RS) GPIO"
            default 8 if IDF_TARGET_ESP32C3
            default 6
        config RAAH_PIN_LCD_MOSI
            int "MOSI (SDI) GPIO"
            default 7
        config RAAH_PIN_LCD_SCLK
            int "SCLK GPIO"
            default 6 if IDF_TARGET_ESP32C3
            default 15
        config RAAH_PIN_LCD_BL
            int "Backlight GPIO"
            default 21 if IDF_TARGET_ESP32C3
            default 16
        config RAAH_LCD_BL_ACTIVE_LOW
            bool "Backlight is active low"
            default n
    endmenu

    config RAAH_BENCH
        bool "Benchmark mode: time the map screen on the real panel instead of running the app"
        default n
        help
            Runs bench/ui_bench.c at boot and prints per-frame pixels, transforms, line segments and
            microseconds for each scenario, once with the SPI transfer and once without it (render alone).

    menu "Power"
        config RAAH_PIN_BUTTON
            int "Button GPIO (must be able to wake the chip from deep sleep)"
            default 5 if IDF_TARGET_ESP32C3
            default 0
            help
                Wire the button between this pin and GND. Only GPIO0-5 wake the C3 from deep sleep, so the
                XIAO uses GPIO5 (D3). On the S3 any RTC GPIO 0-21 does, and GPIO0 is the BOOT button on the
                DevKit, so it works with no extra wiring.
        config RAAH_PIN_BATT_ADC
            int "Battery sense GPIO (ADC1, -1 to disable)"
            default 4 if IDF_TARGET_ESP32C3
            default 1
        config RAAH_BATT_DIVIDER_X100
            int "Battery divider ratio x100 (2 equal resistors = 200)"
            default 200
        config RAAH_PIN_CHARGING
            int "Charger STAT/CHRG GPIO, active low (-1 to disable)"
            default -1
        config RAAH_PIN_LDR_ADC
            int "Ambient light sensor GPIO (ADC1, LDR to 3V3 + resistor to GND, -1 to disable)"
            default 3 if IDF_TARGET_ESP32C3
            default -1
            help
                The case puts a GL5528 behind the lens with 10k to GND, on GPIO3 (D1) of the XIAO.
        config RAAH_LIGHT_SLEEP
            bool "Automatic light sleep (disable while debugging over USB)"
            default y
        config RAAH_WAIT_SCREEN_S
            int "Seconds the 'waiting for phone' screen stays lit"
            default 60
        config RAAH_DEEP_SLEEP_MIN
            int "Minutes without a phone before deep sleep"
            default 15
    endmenu

endmenu
```
